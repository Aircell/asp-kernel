## arch/arm/mach-omap2/Kconfig
```kconfig
comment "OMAP Core Type"
	depends on ARCH_OMAP2

config ARCH_OMAP24XX
	bool "OMAP24xx Based System"
	depends on ARCH_OMAP2

config ARCH_OMAP2420
	bool "OMAP2420 support"
	depends on ARCH_OMAP24XX
	select OMAP_DM_TIMER
	select ARCH_OMAP_OTG

config ARCH_OMAP2430
	bool "OMAP2430 support"
	depends on ARCH_OMAP24XX

config ARCH_OMAP34XX
	bool "OMAP34xx Based System"
	depends on ARCH_OMAP3
	select USB_ARCH_HAS_EHCI

config ARCH_OMAP3430
	bool "OMAP3430 support"
	depends on ARCH_OMAP3 && ARCH_OMAP34XX
	select ARCH_OMAP_OTG

config OMAP_PACKAGE_CBC
       bool

config OMAP_PACKAGE_CBB
       bool

config OMAP_PACKAGE_CUS
       bool

config OMAP_PACKAGE_CBP
       bool

comment "OMAP Board Type"
	depends on ARCH_OMAP2 || ARCH_OMAP3 || ARCH_OMAP4

config MACH_OMAP_GENERIC
	bool "Generic OMAP board"
	depends on ARCH_OMAP2 && ARCH_OMAP24XX

config MACH_OMAP2_TUSB6010
	bool
	depends on ARCH_OMAP2 && ARCH_OMAP2420
	default y if MACH_NOKIA_N8X0

config MACH_OMAP_H4
	bool "OMAP 2420 H4 board"
	depends on ARCH_OMAP2 && ARCH_OMAP24XX
	select OMAP_DEBUG_DEVICES

config MACH_OMAP_APOLLON
	bool "OMAP 2420 Apollon board"
	depends on ARCH_OMAP2 && ARCH_OMAP24XX

config MACH_OMAP_2430SDP
	bool "OMAP 2430 SDP board"
	depends on ARCH_OMAP2 && ARCH_OMAP24XX

config MACH_OMAP3_BEAGLE
	bool "OMAP3 BEAGLE board"
	depends on ARCH_OMAP3 && ARCH_OMAP34XX
	select OMAP_PACKAGE_CBB

config MACH_OMAP_LDP
	bool "OMAP3 LDP board"
	depends on ARCH_OMAP3 && ARCH_OMAP34XX
	select OMAP_PACKAGE_CBB

config MACH_OMAP3530_LV_SOM
	bool "OMAP3 Logic 3530 LV SOM board"
	depends on ARCH_OMAP3 && ARCH_OMAP34XX
	select OMAP_PACKAGE_CBB

config MACH_OMAP3_TORPEDO
	bool "OMAP3 Logic 35x Torpedo board"
	depends on ARCH_OMAP3 && ARCH_OMAP34XX
	select OMAP_PACKAGE_CBB

menuconfig OMAP3LOGIC_BACKUP_BATTERY_ENABLE
	default n
	bool "OMAP3LOGIC backup battery charge enable"
	depends on (MACH_OMAP3530_LV_SOM || MACH_OMAP3_TORPEDO) && TWL4030_BCI_BATTERY

if OMAP3LOGIC_BACKUP_BATTERY_ENABLE

choice
	prompt "Battery charge current"
	default OMAP3LOGIC_BACKUP_BATTERY_C25

config OMAP3LOGIC_BACKUP_BATTERY_C25
	bool "25uA"
	help
		Selects a backup battery charge current of 25uA

config OMAP3LOGIC_BACKUP_BATTERY_C150
	bool "150uA"
	help
		Selects a backup battery charge current of 150uA

config OMAP3LOGIC_BACKUP_BATTERY_C500
	bool "500uA"
	help
		Selects a backup battery charge current of 500uA

config OMAP3LOGIC_BACKUP_BATTERY_C1000
	bool "1000uA"
	help
		Selects a backup battery charge current of 1000uA
endchoice

choice
	prompt "Battery charge voltage"
	default OMAP3LOGIC_BACKUP_BATTERY_V26

config OMAP3LOGIC_BACKUP_BATTERY_V25
	bool "2.5V"
	help
		Selects a backup battery charge voltage of 2.5V

config OMAP3LOGIC_BACKUP_BATTERY_V30
	bool "3.0V"
	help
		Selects a backup battery charge current of 3.0V

config OMAP3LOGIC_BACKUP_BATTERY_V31
	bool "3.1V"
	help
		Selects a backup battery charge current of 3.1V

config OMAP3LOGIC_BACKUP_BATTERY_V32
	bool "3.2V"
	help
		Selects a backup battery charge current of 3.2V
endchoice

endif # if OMAP3LOGIC_BACKUP_BATTERY_ENABLE

menu "OMAP3LOGIC serial ports"
	depends on MACH_OMAP3530_LV_SOM || MACH_OMAP3_TORPEDO

config OMAP3LOGIC_UART_A
	bool "OMAP3 Logic UART A"
	depends on MACH_OMAP3530_LV_SOM || MACH_OMAP3_TORPEDO
	default y
	help
	  Mux/Enable UART A (OMAP UART1) on omap3logic platform

config OMAP3LOGIC_UART_B
	bool "OMAP3 Logic UART B"
	depends on MACH_OMAP3530_LV_SOM || MACH_OMAP3_TORPEDO
	default n
	help
	  Mux/Enable UART B (OMAP UART3) on omap3logic platform

config OMAP3LOGIC_UART_C
	bool "OMAP3 Logic UART C"
	depends on MACH_OMAP3530_LV_SOM || MACH_OMAP3_TORPEDO
	default n
	help
	  Mux/Enable UART C (OMAP UART2) on omap3logic platform
endmenu

menu "OMAP3LOGIC MTD layout"
	depends on (MACH_OMAP3530_LV_SOM || MACH_OMAP3_TORPEDO)

config OMAP3LOGIC_NOR_PARTITION_ONE_NAME
	string "Name of 1st NOR partition"
	depends on (MACH_OMAP3530_LV_SOM)
	default "NOR fs #1"
	help
         Name of the first NOR partition

config OMAP3LOGIC_NOR_PARTITION_ONE_SIZE
       int "Size of 1st NOR partition (in 128KB sectors)"
	depends on (MACH_OMAP3530_LV_SOM)
       default 0
       help
         Size of first NOR partition in 128KB sectors, zero for the rest of the device

config OMAP3LOGIC_NOR_PARTITION_ONE_READONLY
       bool "Set if the 1st NOR partition should be read only"
	depends on (MACH_OMAP3530_LV_SOM)
       default false
       help
         Set the readonly status of the first NOR partition
       
config OMAP3LOGIC_NOR_PARTITION_TWO_NAME
       string "Name of 2nd NOR partition"
       depends on (MACH_OMAP3530_LV_SOM) && (OMAP3LOGIC_NOR_PARTITION_ONE_SIZE != 0)
       default "NOR fs #2"
       help
         Name of the second NOR partition

config OMAP3LOGIC_NOR_PARTITION_TWO_SIZE
       int "Size of 2nd NOR partition (in 128KB sectors)"
       depends on (MACH_OMAP3530_LV_SOM) && (OMAP3LOGIC_NOR_PARTITION_ONE_SIZE != 0)
       default 0
       help
         Size of 2nd NOR partition in 128KB sectors, zero for the rest of the device
config OMAP3LOGIC_NOR_PARTITION_TWO_READONLY
       bool "Set if the 2n NOR partition should be read only"
       depends on (MACH_OMAP3530_LV_SOM) && (OMAP3LOGIC_NOR_PARTITION_ONE_SIZE != 0)
       default false
       help
         Set the readonly status of the second NOR partition

config OMAP3LOGIC_NOR_PARTITION_THREE_NAME
       string "Name of 3rd extra NOR partition"
       depends on (OMAP3LOGIC_NOR_PARTITION_ONE_SIZE != 0) && (OMAP3LOGIC_NOR_PARTITION_TWO_SIZE != 0)
       default "NOR fs #3"
       help
         Name of the third NOR partition
       
config OMAP3LOGIC_NOR_PARTITION_THREE_SIZE
       int "Size of 3rd NOR partition (in 128KB sectors)"
       depends on (OMAP3LOGIC_NOR_PARTITION_ONE_SIZE != 0) && (OMAP3LOGIC_NOR_PARTITION_TWO_SIZE != 0)
       default 0
       help
         Size of third NOR partition in 128KB sectors, zero for the rest of the device

config OMAP3LOGIC_NOR_PARTITION_THREE_READONLY
       bool "Set if the 3rd NOR partition should be read only"
       depends on (OMAP3LOGIC_NOR_PARTITION_ONE_SIZE != 0) && (OMAP3LOGIC_NOR_PARTITION_TWO_SIZE != 0)
       default false
       help
         Set the readonly status of the third NOR partition


config OMAP3LOGIC_NAND_PARTITION_ONE_NAME
       string "Name of 1st extra NAND partition"
	depends on (MACH_OMAP3530_LV_SOM || MACH_OMAP3_TORPEDO)
       default "NAND fs #1"
       help
         Name of first extra NAND partition
       
config OMAP3LOGIC_NAND_PARTITION_ONE_SIZE
       int "Size of 1st extra NAND partition"
	depends on (MACH_OMAP3530_LV_SOM || MACH_OMAP3_TORPEDO)
       default 0
       help
         Size of first extra NAND partition in 128KB blocks, zero for the rest of the device
       
config OMAP3LOGIC_NAND_PARTITION_ONE_READONLY
       bool "Set if the 1st partition should be read only"
	depends on (MACH_OMAP3530_LV_SOM || MACH_OMAP3_TORPEDO)
       default false
       help
         Set the readonly status of the first extra NAND partition

config OMAP3LOGIC_NAND_PARTITION_TWO_NAME
       string "Name of 2nd extra NAND partition"
       depends on (OMAP3LOGIC_NAND_PARTITION_ONE_SIZE != 0)
       default "NAND fs #2"
       help
         Name of second extra NAND partition

config OMAP3LOGIC_NAND_PARTITION_TWO_SIZE
       int "Name of 2nd extra NAND partition"
       depends on (OMAP3LOGIC_NAND_PARTITION_ONE_SIZE != 0)
       default 0
       help
         Size of second extra NAND partition in 128KB blocks, zero for the rest of the device

config OMAP3LOGIC_NAND_PARTITION_TWO_READONLY
       bool "Set if the 2nd partition should be read only"
       depends on (OMAP3LOGIC_NAND_PARTITION_ONE_SIZE != 0)
       default false
       help
         Set the readonly status of the second extra NAND partition

config OMAP3LOGIC_NAND_PARTITION_THREE_NAME
       string "Name of 3rd extra NAND partition"
       depends on (OMAP3LOGIC_NAND_PARTITION_ONE_SIZE != 0) && (OMAP3LOGIC_NAND_PARTITION_TWO_SIZE != 0)
       default "NAND fs #3"
       help
         Name of the third extra NAND partition

config OMAP3LOGIC_NAND_PARTITION_THREE_SIZE
       int "Size of 3rd extra NAND partition"
       depends on (OMAP3LOGIC_NAND_PARTITION_ONE_SIZE != 0) && (OMAP3LOGIC_NAND_PARTITION_TWO_SIZE != 0)
       default 0
       help
         Size of the third extra NAND partition in 128KB blocks, zero for the rest of the device

config OMAP3LOGIC_NAND_PARTITION_THREE_READONLY
       bool "Set if the 3rd partition should be read only"
       depends on (OMAP3LOGIC_NAND_PARTITION_ONE_SIZE != 0) && (OMAP3LOGIC_NAND_PARTITION_TWO_SIZE != 0)
       default false
       help
         Set the readonly status of the third extra NAND partition

endmenu

config MACH_OVERO
	bool "Gumstix Overo board"
	depends on ARCH_OMAP3 && ARCH_OMAP34XX
	select OMAP_PACKAGE_CBB

config MACH_OMAP3EVM
	bool "OMAP 3530 EVM board"
	depends on ARCH_OMAP3 && ARCH_OMAP34XX
	select OMAP_PACKAGE_CBB

config PMIC_TWL4030
	bool "TWL4030/TPS65950 Power Module"
	default y
	depends on TWL4030_CORE && MACH_OMAP3EVM || MACH_OMAP3530_LV_SOM || MACH_OMAP3_TORPEDO
	select REGULATOR_TWL4030 if REGULATOR
	help
	  Say yes here if you are using the TWL4030/TPS65950 based power module
	  for the EVM boards.

config MACH_OMAP3517EVM
	bool "OMAP3517/ AM3517 EVM board"
	depends on ARCH_OMAP3 && ARCH_OMAP34XX
	select OMAP_PACKAGE_CBB

config PMIC_TPS65023
	bool "TPS65023 Power Module"
	default y
	depends on I2C=y && MACH_OMAP3517EVM
	select REGULATOR_TPS65023 if REGULATOR
	help
	  Say yes here if you are using the TPS65023 based power module for the
	  EVM boards.

config MACH_OMAP3_PANDORA
	bool "OMAP3 Pandora"
	depends on ARCH_OMAP3 && ARCH_OMAP34XX
	select OMAP_PACKAGE_CBB

config MACH_OMAP3_TOUCHBOOK
	bool "OMAP3 Touch Book"
	depends on ARCH_OMAP3 && ARCH_OMAP34XX
	select BACKLIGHT_CLASS_DEVICE

config MACH_OMAP_3430SDP
	bool "OMAP 3430 SDP board"
	depends on ARCH_OMAP3 && ARCH_OMAP34XX
	select OMAP_PACKAGE_CBB

config MACH_NOKIA_N800
       bool

config MACH_NOKIA_N810
       bool

config MACH_NOKIA_N810_WIMAX
       bool

config MACH_NOKIA_N8X0
	bool "Nokia N800/N810"
	depends on ARCH_OMAP2420
	select MACH_NOKIA_N800
	select MACH_NOKIA_N810
	select MACH_NOKIA_N810_WIMAX

config MACH_NOKIA_RX51
	bool "Nokia RX-51 board"
	depends on ARCH_OMAP3 && ARCH_OMAP34XX
	select OMAP_PACKAGE_CBB

config MACH_OMAP_ZOOM2
	bool "OMAP3 Zoom2 board"
	depends on ARCH_OMAP3 && ARCH_OMAP34XX
	select OMAP_PACKAGE_CBB

config MACH_OMAP_ZOOM3
	bool "OMAP3630 Zoom3 board"
	depends on ARCH_OMAP3 && ARCH_OMAP34XX
	select OMAP_PACKAGE_CBP

config WLAN_1273
        bool "TI WLAN 1273 support"
	select TIWLAN_SDIO
	depends on MACH_OMAP3530_LV_SOM || MACH_OMAP3_TORPEDO || MACH_AM3517EVM
	help
	  Enables wl1273 support

config WIFI_CONTROL_FUNC
	bool "Enable WiFi control function abstraction"
	select MMC_EMBEDDED_SDIO
	select WIRELESS_EXT
	select WEXT_PRIV
	help
	Enables Power/Reset/Carddetect function abstraction

config TIWLAN_SDIO
	bool "TI WLAN Enhanced SDIO Contoller support"
	select WIFI_CONTROL_FUNC
	help
	Say Y here if you want to be able to use TI's WLAN device using the
	SDIO interface. If unsure, say N.

config TIWLAN_MMC_CONTROLLER
	int "MMC Controller number that TI WLAN chip is connected to"
	range 1 3
	depends on TIWLAN_SDIO || MMC_EMBEDDED_SDIO
	default "3"
	help
	Choose the number of the MMC controller that TI WLAN chip is
	connected to. TI WLAN has SDIO host controller that will control
	this MMC port.

config MACH_CM_T35
	bool "CompuLab CM-T35 module"
	depends on ARCH_OMAP3 && ARCH_OMAP34XX
	select OMAP_PACKAGE_CUS
	select OMAP_MUX

config MACH_IGEP0020
	bool "IGEP0020"
	depends on ARCH_OMAP3 && ARCH_OMAP34XX
	select OMAP_PACKAGE_CBB

config MACH_OMAP_3630SDP
	bool "OMAP3630 SDP board"
	depends on ARCH_OMAP3 && ARCH_OMAP34XX
	select OMAP_PACKAGE_CBP

config MACH_OMAP_4430SDP
	bool "OMAP 4430 SDP board"
	depends on ARCH_OMAP4

config OMAP3_EMU
	bool "OMAP3 debugging peripherals"
	depends on ARCH_OMAP3
	select OC_ETM
	help
	  Say Y here to enable debugging hardware of omap3

config OMAP3_SDRC_AC_TIMING
	bool "Enable SDRC AC timing register changes"
	depends on ARCH_OMAP3 && ARCH_OMAP34XX
	default n
	help
	  If you know that none of your system initiators will attempt to
	  access SDRAM during CORE DVFS, select Y here.  This should boost
	  SDRAM performance at lower CORE OPPs.  There are relatively few
	  users who will wish to say yes at this point - almost everyone will
	  wish to say no.  Selecting yes without understanding what is
	  going on could result in system crashes;
```

## drivers/media/video/isp/Kconfig
```kconfig
# Kconfig for OMAP3 ISP driver

config VIDEO_OMAP3_ISP
	bool
	select VIDEOBUF_GEN
	select VIDEOBUF_DMA_SG
	select OMAP_IOMMU

if VIDEO_OMAP3_ISP

config VIDEO_OMAP3_ISP_PROC
	bool "ISP Register debugging proc files"
	depends on  VIDEO_OMAP3_ISP

config VIDEO_OMAP3_ISP_DEBUG
	bool "ISP Register dumps"
	depends on  VIDEO_OMAP3_ISP

endif

config VIDEO_OMAP34XX_ISP_PREVIEWER
	tristate "OMAP ISP Previewer"
	depends on !ARCH_OMAP3410
	select VIDEO_OMAP3_ISP


config VIDEO_OMAP34XX_ISP_RESIZER
	tristate "OMAP ISP Resizer"
	depends on !ARCH_OMAP3410
	select VIDEO_OMAP3_ISP
```

## drivers/usb/pehcd/Kconfig
```kconfig
#
# USB Host Controller Drivers
#
config USB_ISP1760_HCD_OMAP3LOGIC
	tristate "ISP 1760 HCD support on Logic OMAP3 Reference boards"
	depends on USB && EXPERIMENTAL && (MACH_OMAP3530_LV_SOM || MACH_OMAP3_TORPEDO)
	---help---
	  The ISP1760 chip is a USB 2.0 host controller.
	  This driver supports ISP1760 USB host controller embedded
	  on Logic OMAP35xx reference boards

config USB_ISP1760_OMAP3LOGIC_OC_WORKAROUND
	bool "ISP 1760 software workaround of over current issue on Logic OMAP3530 LV SOM"
	depends on USB_ISP1760_HCD_OMAP3LOGIC
	---help---
	  To work around an over current issue on downstream port 2 and 3 of Logic OMAP3530 LV SOM, the 
          software workaround enables only downstream port 1 of ISP1760's internal built-in hub ISP1520.
```

## drivers/video/omap2/displays/Kconfig
```kconfig
menu "OMAP2/3 Display Device Drivers"
        depends on OMAP2_DSS

config PANEL_GENERIC
        tristate "Generic Panel"
        help
	  Generic panel driver.
	  Used for DVI output for Beagle and OMAP3 SDP.

config PANEL_LGPHILIPS_LB035Q02
	tristate "LG.Philips LB035Q02 LCD Panel"
	depends on OMAP2_DSS
	help
	  LCD Panel used on Overo Palo35

config PANEL_SAMSUNG_LTE430WQ_F0C
        tristate "Samsung LTE430WQ-F0C LCD Panel"
        depends on OMAP2_DSS
        help
          LCD Panel used on Overo Palo43

config PANEL_SHARP_LS037V7DW01
        tristate "Sharp LS037V7DW01 LCD Panel"
        depends on OMAP2_DSS
        help
          LCD Panel used in TI's SDP3430 and EVM boards

config PANEL_SHARP_LQ036Q1DA01
        tristate "Sharp LQ036Q1DA01 LCD Panel"
        depends on OMAP2_DSS
        help
          LCD Panel used in Logic's OMAP boards

config PANEL_SHARP_LQ043T1DG01
        tristate "Sharp LQ043T1DG01 LCD Panel"
        depends on OMAP2_DSS
        help
          LCD Panel used in TI's OMAP3517 EVM boards

config PANEL_SHARP_LQ10D368
        tristate "Sharp LQ10D368 LCD Panel"
        depends on OMAP2_DSS
        help
          LCD Panel used in Logic's OMAP boards

config PANEL_SHARP_LQ121S1DG31
        tristate "Sharp LQ121S1DG31 LCD Panel"
        depends on OMAP2_DSS
        help
          LCD Panel used in Logic's OMAP boards

config PANEL_SHARP_LQ64D343
        tristate "Sharp LQ64D343 LCD Panel"
        depends on OMAP2_DSS
        help
          LCD Panel used in Logic's OMAP boards
config PANEL_TAAL
        tristate "Taal DSI Panel"
        depends on OMAP2_DSS_DSI
        help
          Taal DSI command mode panel from TPO.

config PANEL_CUSTOMER
        tristate "Customer LCD Panel"
        help
	  Cusomer LCD Panel driver.

endmenu
```
